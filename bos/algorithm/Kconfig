## bos/services/Kconfig
```kconfig
# Services Configuration
menu "Services Configuration"

config _BOS_SERVICES_ENABLE
    bool "Services Enable/Disable"
    default y

#======================================== TCP/IP ========================================
config _TCPIP_SERVICE_ENABLE
    bool "TCP/IP Service"
    default n
    depends on _BOS_SERVICES_ENABLE
    select _MEMP_ENABLE
    select _TCPIP_ENABLE
    help
        TCP/IP stack initialization wrapper for netcard registration.

#======================================== HTTP Service ========================================
config _HTTP_SERVICE_ENABLE
    bool "HTTP Service"
    default n
    depends on _BOS_SERVICES_ENABLE
    help
        HTTP client and server functionality.

if _HTTP_SERVICE_ENABLE

# HTTP Client
config _HTTP_CLIENT_ENABLE
    bool "HTTP Client"
    default n
    select _TCPIP_SERVICE_ENABLE
    select _HTTP_PARSER_ENABLE
    help
        Enable HTTP client for making requests.

if _HTTP_CLIENT_ENABLE

config _HTTP_HOST_LEN_MAX
    int "Maximum URL host length"
    default 64
    help
        Maximum length of hostname (e.g., example.com).

config _HTTP_PATH_LEN_MAX
    int "Maximum URL path length"
    default 128
    help
        Maximum length of URL path (e.g., /api/data).

endif

# HTTP Server
config _HTTP_SERVER_ENABLE
    bool "HTTP Server"
    default n
    select _TCPIP_SERVICE_ENABLE
    select _HTTP_PARSER_ENABLE
    help
        Enable HTTP server for handling requests.

endif

#======================================== NTP Service ========================================
config _NTP_SERVICE_ENABLE
    bool "NTP Service"
    default n
    depends on _BOS_SERVICES_ENABLE
    select _TCPIP_SERVICE_ENABLE
    help
        Network Time Protocol synchronization.

if _NTP_SERVICE_ENABLE

config _NTP_SERVER_1
    string "NTP Server 1"
    default "ntp1.aliyun.com"

config _NTP_SERVER_2
    string "NTP Server 2"
    default "ntp2.aliyun.com"

config _NTP_SERVER_3
    string "NTP Server 3"
    default "ntp3.aliyun.com"

endif

#======================================== Protocol ========================================
config _PROTOCOL_SERVICE_ENABLE
    bool "Protocol Service"
    default n
    depends on _BOS_SERVICES_ENABLE
    help
        Generic protocol service for communication.

#======================================== OTA ========================================
config _OTA_SERVICE_ENABLE
    bool "OTA Service"
    default n
    depends on _BOS_SERVICES_ENABLE
    select _PROTOCOL_SERVICE_ENABLE
    select _IAP_ENABLE
    help
        Over-The-Air firmware update service.

if _OTA_SERVICE_ENABLE

config OTA_TIMEOUT_S
    int "OTA timeout (seconds)"
    default 30

endif

#======================================== MQTT ========================================
config _MQTT_SERVICE_ENABLE
    bool "MQTT Service"
    default n
    depends on _BOS_SERVICES_ENABLE
    select _TCPIP_SERVICE_ENABLE
    help
        MQTT client for IoT communication.

if _MQTT_SERVICE_ENABLE

choice
    prompt "MQTT Broker"
    default BABYOS_MQTT_BROKER
config BABYOS_MQTT_BROKER
    bool "BabyOS MQTT Broker"
config RESERVED_BROKER
    bool "Reserved"
endchoice

if BABYOS_MQTT_BROKER

config MQTT_CLIENT_ID
    string "MQTT Client ID"
    default "babyos"

config MQTT_BROKER_URL
    string "MQTT Broker URL"
    default "mqtt://babyos.cn:1883"

config MQTT_USER_NAME
    string "MQTT Username"
    default "babyos"

config MQTT_USER_PASSWD
    string "MQTT Password"
    default "babyos"

config MQTT_SUB_TOPIC_DEFAULT
    string "Default subscription topic"
    default "ogugO0zq_Qi7O3HxQn9G4X2rhH"

config MQTT_QOS_DEFAULT
    int "Default QoS (0-2)"
    default 0
    range 0 2

config MQTT_KEEP_ALIVE
    int "Keep alive interval (seconds)"
    default 60

endif

endif

#======================================== File Transfer ========================================
config _TRANSFILE_SERVICE_ENABLE
    bool "File Transfer Service"
    default n
    depends on _BOS_SERVICES_ENABLE
    select _PROTOCOL_SERVICE_ENABLE
    help
        YMODEM/XMODEM file transfer service.

endmenu
```

## bos/thirdparty/Kconfig
```kconfig
# Thirdparty Components Configuration
menu "Thirdparty Configuration"

#======================================== CmBackTrace ========================================
config _CMBACKTRACE_ENABLE
    bool "CmBackTrace (ARM crash dump)"
    default n

if _CMBACKTRACE_ENABLE

choice
    prompt "ARM Cortex-M core"
config TRACE_ARM_CORTEX_M0
    bool "Cortex-M0"
config TRACE_ARM_CORTEX_M3
    bool "Cortex-M3"
config TRACE_ARM_CORTEX_M4
    bool "Cortex-M4"
config TRACE_ARM_CORTEX_M7
    bool "Cortex-M7"
config TRACE_ARM_CORTEX_M33
    bool "Cortex-M33"
endchoice

endif

#======================================== NR Micro Shell ========================================
config _NR_MICRO_SHELL_ENABLE
    bool "NR Micro Shell"
    default n

if _NR_MICRO_SHELL_ENABLE

config NR_SHELL_USER_NAME
    string "Shell prompt username"
    default "nr@bos:"

config NR_ANSI_LINE_SIZE
    int "Command line buffer size"
    default 100

config NR_SHELL_USER_NAME_MAX_LENGTH
    int "Maximum username length"
    default 30

config NR_SHELL_CMD_NAME_MAX_LENGTH
    int "Maximum command name length"
    default 16

config NR_SHELL_CMD_PARAS_MAX_NUM
    int "Maximum parameters per command"
    default 10

config NR_SHELL_MAX_CMD_HISTORY_NUM
    int "Command history count (0-3)"
    default 1
    range 0 3

config NR_SHELL_CMD_HISTORY_BUF_LENGTH
    int "Command history buffer length"
    default 100

config NR_SHELL_END_OF_LINE
    int "Line ending (0: \n, 1: \r, 2: \r\n)"
    default 1
    range 0 2

config NR_SHLL_FULL_ANSI
    bool "Full ANSI escape codes"
    default y

config NR_SHELL_ECHO_ENABLE
    bool "Echo input characters"
    default y

endif

#======================================== Flexible Button ========================================
config _FLEXIBLEBUTTON_ENABLE
    bool "Flexible Button"
    default n

if _FLEXIBLEBUTTON_ENABLE

config FLEX_BTN_SCAN_FREQ_HZ
    int "Button scan frequency (Hz)"
    default 50

config FLEX_BTN_SHORT_XMS
    int "Short press threshold (ms)"
    default 1000

config FLEX_BTN_LONG_XMS
    int "Long press threshold (ms)"
    default 3000

config FLEX_BTN_LLONG_XMS
    int "Long-long press threshold (ms)"
    default 5000

config MULTIPLE_CLICKS_INTERVAL_XMS
    int "Multiple clicks interval (ms)"
    default 300

endif

#======================================== uGUI ========================================
config _UGUI_ENABLE
    bool "uGUI"
    default n

if _UGUI_ENABLE

choice
    prompt "Font"
config GUI_FONT_6X8
    bool "6x8"
config GUI_FONT_8X12
    bool "8x12"
config GUI_FONT_12X16
    bool "12x16"
config GUI_FONT_XBF
    bool "XBF (external)"
endchoice

if GUI_FONT_XBF

config XBF_FILE_ADDR
    hex "XBF font file address"
    default 0x0

endif

choice
    prompt "Encoding"
config ENCODING_UTF_8
    bool "UTF-8"
config ENCODING_UNICODE
    bool "UNICODE"
endchoice

endif

#======================================== cJSON ========================================
config _CJSON_ENABLE
    bool "cJSON"
    default n

if _CJSON_ENABLE

config CJSON_MEM_USE_BMALLOC
    bool "Use bMalloc/bFree"
    default y
    select _MEMP_ENABLE

endif

#======================================== CoreMark ========================================
config _COREMARK_ENABLE
    bool "CoreMark Benchmark"
    default n

if _COREMARK_ENABLE

config HAS_FLOAT
    bool "Has floating point"
    default y

config COMPILER_VERSION
    string "Compiler version"
    default "ARMCC V5.06"

config COMPILER_FLAGS
    string "Compiler flags"
    default "-O3"

endif

#======================================== Unity (Unit Testing) ========================================
config _UNITY_ENABLE
    bool "Unity (Unit Testing)"
    default n

#======================================== ARM-2D ========================================
config _ARM_2D_ENABLE
    bool "ARM-2D"
    default n

#======================================== QRCode ========================================
config _QRCODE_ENABLE
    bool "QRCode"
    default n

#======================================== HTTP Parser ========================================
config _HTTP_PARSER_ENABLE
    bool "HTTP Parser"
    default n

#======================================== TinyUSB ========================================
config _TINYUSB_ENABLE
    bool "TinyUSB"
    default n

if _TINYUSB_ENABLE

config CFG_TUSB_CONFIG_FILE
    string "Custom configuration file"
    default "b_usb_config.h"

endif

#======================================== mbedTLS ========================================
config _MBEDTLS_ENABLE
    bool "mbedTLS"
    default n
    select _MEMP_ENABLE

if _MBEDTLS_ENABLE

config MBEDTLS_CONFIG_FILE
    string "mbedTLS config file"
    default "b_mbedtls_config.h"

config MBEDTLS_DEBUG_LEVEL
    int "Debug level (0-4)"
    default 0
    range 0 4

endif

#======================================== LVGL ========================================
config _LVGL_ENABLE
    bool "LVGL"
    default n
    select _MEMP_ENABLE

if _LVGL_ENABLE

config LV_CONF_INCLUDE_SIMPLE
    bool "Simply include lv_conf.h"
    default y

endif

#======================================== Lua ========================================
config _LUA_ENABLE
    bool "Lua Scripting"
    default n
    select _MEMP_ENABLE

if _LUA_ENABLE

config _LUA_MATH_ENABLE
    bool "Lua math library"
    default n

config _LUA_UTF8_ENABLE
    bool "Lua UTF-8 support"
    default n

endif

endmenu
```

## bos/utils/Kconfig
```kconfig
# Utils Configuration
menu "Utils Configuration"

#======================================== Debug/Log ========================================
config _DEBUG_ENABLE
    bool "Debug Enable/Disable"
    default y

if _DEBUG_ENABLE

choice
    prompt "Log level"
    default LOG_LEVEL_ALL
config LOG_LEVEL_ALL
    bool "All (debug + info + warning + error)"
config LOG_LEVEL_INFO
    bool "Info level and above"
config LOG_LEVEL_WARNING
    bool "Warning level and above"
config LOG_LEVEL_ERROR
    bool "Error level only"
config LOG_LEVEL_CUSTOMIZE
    bool "User-defined levels"
endchoice

if LOG_LEVEL_CUSTOMIZE

config _B_LOG_ENABLE
    bool "b_log (debug)"
    default y

config _B_LOG_I_ENABLE
    bool "b_log_i (info)"
    default y

config _B_LOG_W_ENABLE
    bool "b_log_w (warning)"
    default y

config _B_LOG_E_ENABLE
    bool "b_log_e (error)"
    default y

endif

config LOG_BUF_SIZE
    int "Log buffer size (bytes)"
    default 256
    range 64 1024

choice
    prompt "Log output channel"
    default _LOG_VIA_UART
config _LOG_VIA_UART
    bool "Serial port"
config _LOG_VIA_USER_SPECIFIED
    bool "User-defined"
endchoice

if _LOG_VIA_UART

config LOG_UART
    int "UART (0-7: B_HAL_UART_1-8, 8-11: B_HAL_LPUART_1-4)"
    default 0
    range 0 11

endif

endif

#======================================== Memory Pool ========================================
config _MEMP_ENABLE
    bool "Memory Pool"
    default n

if _MEMP_ENABLE

config MEMP_MAX_SIZE
    int "Maximum memory block size (bytes)"
    default 10240 if !_MBEDTLS_ENABLE
    default 40960

config _MEMP_WATERLINE_ENABLE
    bool "Waterline monitoring"
    default n

config _MEMP_MONITOR_ENABLE
    bool "Memory pool monitor"
    default n

endif

#======================================== AT Command ========================================
config _AT_ENABLE
    bool "AT Command"
    default n

if _AT_ENABLE

config _AT_DYNAMIC_ENABLE
    bool "Dynamic response data allocation"
    default n
    select _MEMP_ENABLE if _AT_DYNAMIC_ENABLE

endif

endmenu
```
