## bos/modules/Kconfig
```kconfig
# Modules Configuration
menu "Modules Configuration"

config _BOS_MODULES_ENABLE
    bool "Modules Enable/Disable"
    default y

#======================================== ADC Hub ========================================
config _ADCHUB_ENABLE
    bool "ADC Hub"
    default n
    depends on _BOS_MODULES_ENABLE

if _ADCHUB_ENABLE

config FILTER_BUF_SIZE
    int "ADC filter buffer size"
    default 10

endif

#======================================== Error Management ========================================
config _ERROR_MANAGE_ENABLE
    bool "Error Management"
    default n
    depends on _BOS_MODULES_ENABLE

if _ERROR_MANAGE_ENABLE

config ERROR_Q_LENGTH
    int "Error queue length"
    default 10

endif

#======================================== File System ========================================
config _FS_ENABLE
    bool "File System"
    default n
    depends on _BOS_MODULES_ENABLE

if _FS_ENABLE

config FS_FATFS
    bool "FatFS"
    default y

config FS_LITTLEFS
    bool "LittleFS"
    default n

if FS_LITTLEFS

config LFS_CONFIG
    string "LittleFS config header file"
    default "b_lfs_config.h"

endif

config FS_MOUNT_NUMBER
    int "Maximum number of mounts"
    default 1
    range 1 10

config FS_BLOCK_SIZE
    int "Block size (minimum erasure units)"
    default 1

config _FS_MKFS_ENABLE
    bool "Enable filesystem creation (mkfs)"
    default n

endif

#======================================== Modbus ========================================
config _MODBUS_ENABLE
    bool "Modbus"
    default n
    depends on _BOS_MODULES_ENABLE
    select _BOS_ALGO_ENABLE
    select _ALGO_CRC_ENABLE
    select _ALGO_CRC16_MODBUS_ENABLE
    select _BOS_SERVICES_ENABLE
    select _PROTOCOL_SERVICE_ENABLE

if _MODBUS_ENABLE

config MY_DEVICE_MODBUS_REG_NUM
    int "Maximum register number"
    default 36

config SLAVE_ADDR
    int "Slave address (for slave mode)"
    default 1

endif

#======================================== Protocol ========================================
config _PROTO_ENABLE
    bool "Protocol"
    default n
    depends on _BOS_MODULES_ENABLE
    select _BOS_SERVICES_ENABLE
    select _PROTOCOL_SERVICE_ENABLE

if _PROTO_ENABLE

choice
    prompt "Protocol role"
    default PROTO_ROLE_MCU
config PROTO_ROLE_MCU
    bool "MCU (device)"
    help
        Select if protocol is used by the microcontroller.
config PROTO_ROLE_HOST
    bool "Host"
    help
        Select if protocol is used by the upper-level system.
endchoice

config PROTO_FID_SIZE
    int "Device ID field size (bytes)"
    default 4
    range 2 4

config PROTO_FLEN_SIZE
    int "Length field size (bytes)"
    default 2
    range 1 2

config _PROTO_ENCRYPT_ENABLE
    bool "Encryption"
    default n

if _PROTO_ENCRYPT_ENABLE

config SECRET_KEY1
    int "Secret key 1"
    default 1

config SECRET_KEY2
    int "Secret key 2"
    default 22

config SECRET_KEY3
    int "Secret key 3"
    default 333

config SECRET_KEY4
    int "Secret key 4"
    default 4444

endif

endif

#======================================== KV Storage ========================================
config _KV_ENABLE
    bool "KV Storage"
    default n
    depends on _BOS_MODULES_ENABLE
    select _BOS_ALGO_ENABLE
    select _ALGO_CRC_ENABLE
    select _ALGO_CRC32_ENABLE

if _KV_ENABLE

config _KV_MD5_ENABLE
    bool "MD5 verification"
    default n
    select _ALGO_MD5_ENABLE

config _KV_ENCRYPT_ENABLE
    bool "Data encryption"
    default n

if _KV_ENCRYPT_ENABLE

config _KV_ENCRYPT_KEY
    int "Encryption key (0-255)"
    default 111

endif

endif

#======================================== File Transfer ========================================
config _XMODEM128_ENABLE
    bool "XMODEM-128"
    default n
    depends on _BOS_MODULES_ENABLE
    select _BOS_SERVICES_ENABLE
    select _PROTOCOL_SERVICE_ENABLE

config _YMODEM_ENABLE
    bool "YMODEM"
    default n
    depends on _BOS_MODULES_ENABLE
    select _BOS_SERVICES_ENABLE
    select _PROTOCOL_SERVICE_ENABLE

#======================================== Menu ========================================
config _MENU_ENABLE
    bool "Menu"
    default n
    depends on _BOS_MODULES_ENABLE

if _MENU_ENABLE

config MENU_ITEM_NUMBER
    int "Menu item number"
    default 10

endif

#======================================== PWM ========================================
config _PWM_ENABLE
    bool "Software PWM"
    default n
    depends on _BOS_MODULES_ENABLE

#======================================== Tuning Parameters ========================================
config _PARAM_ENABLE
    bool "Tuning Parameters"
    default n
    depends on _BOS_MODULES_ENABLE
    select _NR_MICRO_SHELL_ENABLE

#======================================== State Machine ========================================
config _STATE_ENABLE
    bool "State Machine"
    default n
    depends on _BOS_MODULES_ENABLE

#======================================== IAP / OTA ========================================
config _IAP_ENABLE
    bool "IAP (In-Application Programming)"
    default n
    depends on _BOS_MODULES_ENABLE
    select _BOS_ALGO_ENABLE
    select _ALGO_CRC_ENABLE
    select _ALGO_CRC32_ENABLE

if _IAP_ENABLE

config MCUFLASH_BASE_ADDR
    hex "MCU Flash base address"
    default 0x8000000

config BOOT_START_ADDR
    hex "Bootloader start address"
    default 0x8000000

config IAP_FLAG_ADDR
    hex "IAP flag address"
    default 0x8014000

config APP_START_ADDR
    hex "Application start address"
    default 0x8014800

config RECEIVE_FIRMWARE_MODE
    int "Receive firmware mode (0: boot, 1: app)"
    default 1
    range 0 1

config IAP_FILE_CACHE
    int "File cache (0: none, 1: flash, 2: spiflash)"
    default 2
    range 0 2

config IAP_FW_SAVE_ADDR
    hex "Firmware save address"
    default 0x0

config _BACKUP_ENABLE
    bool "Backup support"
    default n

if _BACKUP_ENABLE

config IAP_BACKUP_LOCATION
    int "Backup location (0: flash, 1: spiflash)"
    default 1
    range 0 1

config IAP_BACKUP_ADDR
    hex "Backup address"
    default 0x32000

config IAP_BACKUP_SIZE
    hex "Backup area size"
    default 0x14000

endif

endif

#======================================== WiFi ========================================
config _WIFI_ENABLE
    bool "WiFi"
    default n
    depends on _BOS_MODULES_ENABLE
    select _CJSON_ENABLE
    select _MEMP_ENABLE

#======================================== Select/I/O Multiplexing ========================================
config _SELECT_ENABLE
    bool "Select (I/O Multiplexing)"
    default n
    depends on _BOS_MODULES_ENABLE

if _SELECT_ENABLE

config SELECT_FDS_NUMBER
    int "Maximum fd number"
    default 32

endif

#======================================== GUI ========================================
config _GUI_ENABLE
    bool "GUI"
    default n
    depends on _BOS_MODULES_ENABLE

if _GUI_ENABLE

config GUI_REFR_PERIOD
    int "GUI refresh period (ms)"
    default 33

choice
    prompt "Color format"
    default _GUI_RGB_565
config _GUI_RGB_888
    bool "RGB888"
config _GUI_RGB_565
    bool "RGB565"
config _GUI_RGB_8BIT
    bool "RGB 8-bit"
endchoice

# uGUI
config _USE_UGUI
    bool "Use uGUI"
    default y
    select _UGUI_ENABLE

# LVGL
config _USE_LVGL
    bool "Use LVGL"
    default n
    select _LVGL_ENABLE

if _USE_LVGL

config LVGL_DISP_BUF_NUM
    int "LVGL display buffer count"
    default 1
    range 1 2

endif

# ARM-2D
config _USE_ARM_2D
    bool "Use ARM-2D"
    default n
    select _ARM_2D_ENABLE

if _USE_ARM_2D

config PFB_WIDTH
    int "PFB block width"
    default 16

config PFB_HEIGHT
    int "PFB block height"
    default 16

config __ARM_2D_HAS_ASYNC__
    bool "Enable async programming model"
    default n

config __ARM_2D_HAS_ANTI_ALIAS_TRANSFORM__
    bool "Enable anti-alias transform"
    default y

config __ARM_2D_CFG_SUPPORT_COLOUR_CHANNEL_ACCESS__
    bool "Enable color channel access"
    default y

config __ARM_2D_CFG_OPTIMIZE_FOR_POINTER_LIKE_SHAPES_IN_TRANSFORM__
    bool "Optimize for pointer-like shapes"
    default y

config __LCD_PRINT_ENABLE
    bool "Enable LCD printf"
    default n

config __LCD_PRINTF_CFG_TEXT_BUFFER_SIZE__
    int "LCD printf text buffer size"
    default 16
    range 16 65535

config __GLCD_CFG_SCEEN_WIDTH__
    int "Screen width"
    default 240
    range 8 32767

config __GLCD_CFG_SCEEN_HEIGHT__
    int "Screen height"
    default 320
    range 8 32767

endif

endif

#======================================== TCP/IP ========================================
config _TCPIP_ENABLE
    bool "TCP/IP Stack"
    default n
    depends on _BOS_MODULES_ENABLE

if _TCPIP_ENABLE

config _TCPIP_RECV_BUF_ENABLE
    bool "Receive buffer"
    default n

if _TCPIP_RECV_BUF_ENABLE

config TCPIP_RECV_BUF_LEN_MAX
    int "Receive buffer max length"
    default 2048

endif

config _TCPIP_SEND_BUF_ENABLE
    bool "Send buffer"
    default n

if _TCPIP_SEND_BUF_ENABLE

config TCPIP_SEND_BUF_LEN_MAX
    int "Send buffer max length"
    default 2048

endif

config TCPIP_DNS_CACHE_NUM
    int "DNS cache entries"
    default 5

config REMOTE_ADDR_LEN_MAX
    int "Remote address max length"
    default 128

config CONNECT_RECVBUF_MAX
    int "Connection receive buffer max length"
    default 2048

config SERVER_MAX_CONNECTIONS
    int "Server max connections"
    default 2

# LWIP
config _TCPIP_STACK_LWIP_ENABLE
    bool "LWIP TCP/IP stack"
    default y

if _TCPIP_STACK_LWIP_ENABLE

config TCPIP_CHECKSUM_BY_HARDWARE
    bool "Hardware checksum offload"
    default n

config MEM_SIZE_FOR_LWIP
    int "LWIP heap memory size"
    default 10240

config _LWIP_DEBUG_ENABLE
    bool "LWIP debug"
    default n

endif

config _TCPIP_DNS_DEBUG_ENABLE
    bool "DNS debug"
    default n

config _TCPIP_DHCP_DEBUG_ENABLE
    bool "DHCP debug"
    default n

endif

#======================================== USB ========================================
config _USB_ENABLE
    bool "USB"
    default n
    depends on _BOS_MODULES_ENABLE
    select _TINYUSB_ENABLE

if _USB_ENABLE

config USB_MANUFACTURER
    string "Manufacturer"
    default "BabyOS"

config USB_PRODUCT
    string "Product"
    default "BabyOS-USB"

config USB_SERIAL_NUMBER
    string "Serial number"
    default "BabyOS-USB0"

endif

#======================================== SSL/TLS ========================================
config _SSL_ENABLE
    bool "SSL/TLS"
    default n
    depends on _BOS_MODULES_ENABLE
    select _MBEDTLS_ENABLE

if _SSL_ENABLE

config _SSL_DEFAULT_CERT_ENABLE
    bool "Use default certificate"
    default y
    help
      Embed default root CA certificates (_config/b_mbedtls_config.h).
      Required to verify HTTPS server certificates.
      Always enable for HTTP client functionality.

config _SSL_SKIP_HOSTNAME_VERIFY
    bool "Skip TLS hostname verification (test only)"
    default n
    help
      WARNING: Only enable for development/testing!
      Skips CN/SAN check between URL host and certificate subject.
      Certificate chain validation (signature, expiry, etc.) still runs.
      Disable in production to prevent MITM attacks.

config _SSL_VERIFY_ENABLE
    bool "Enable server certificate verification"
    default n
    help
      Enable CA chain + expiry validation for server certificates.
      Disable for self-signed certs or development/testing.
      Hostname verification is controlled separately by _SSL_SKIP_HOSTNAME_VERIFY.

# mbedTLS细粒度配置（用于优化Flash占用）
config _MBEDTLS_DEBUG_ENABLE
    bool "mbedTLS debug output"
    default n
    help
      Enable mbedTLS debug log output. Disable in production to save ~5-10KB Flash.

config _MBEDTLS_SHA384_ENABLE
    bool "SHA-384 support"
    default n
    help
      Required for AES-256-GCM-SHA384 cipher suite.
      Enable if you need AES-256 strength; otherwise SHA-256 is sufficient.

config _MBEDTLS_PEM_PARSE_ENABLE
    bool "PEM certificate parsing"
    default y
    help
      Required for parsing PEM-formatted certificates (most common).
      Disable only if you use DER-formatted certificates exclusively.
      Saves ~3-4KB Flash when disabled.

endif

endmenu
```
