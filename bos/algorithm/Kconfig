## bos/algorithm/Kconfig
```kconfig
# Algorithm Configuration
menu "Algorithm Configuration"

config _BOS_ALGO_ENABLE
    bool "Algorithm Enable/Disable"
    default y

#======================================== Base64 ========================================
config _ALGO_BASE64_ENABLE
    bool "Base64 Encode/Decode"
    default n
    depends on _BOS_ALGO_ENABLE

#======================================== SHA1 ========================================
config _ALGO_SHA1_ENABLE
    bool "SHA1"
    default n
    depends on _BOS_ALGO_ENABLE

#======================================== Sort ========================================
config _ALGO_SORT_ENABLE
    bool "Sort Algorithm"
    default n
    depends on _BOS_ALGO_ENABLE

#======================================== Unicode ========================================
config _ALGO_UNICODE_ENABLE
    bool "Unicode"
    default n
    depends on _BOS_ALGO_ENABLE

#======================================== MD5 ========================================
config _ALGO_MD5_ENABLE
    bool "MD5"
    default n
    depends on _BOS_ALGO_ENABLE

#======================================== CRC ========================================
config _ALGO_CRC_ENABLE
    bool "CRC Algorithms"
    default n
    depends on _BOS_ALGO_ENABLE

if _ALGO_CRC_ENABLE

config _ALGO_CRC8_ENABLE
    bool "CRC8"
    default n

config _ALGO_CRC8_ITU_ENABLE
    bool "CRC8-ITU"
    default n

config _ALGO_CRC8_ROHC_ENABLE
    bool "CRC8-ROHC"
    default n

config _ALGO_CRC8_MAXIM_ENABLE
    bool "CRC8-MAXIM"
    default n

config _ALGO_CRC16_IBM_ENABLE
    bool "CRC16-IBM"
    default n

config _ALGO_CRC16_MAXIM_ENABLE
    bool "CRC16-MAXIM"
    default n

config _ALGO_CRC16_USB_ENABLE
    bool "CRC16-USB"
    default n

config _ALGO_CRC16_MODBUS_ENABLE
    bool "CRC16-MODBUS"
    default n

config _ALGO_CRC16_CCITT_ENABLE
    bool "CRC16-CCITT"
    default n

config _ALGO_CRC16_CCITT_FALSE_ENABLE
    bool "CRC16-CCITT-FALSE"
    default n

config _ALGO_CRC16_X25_ENABLE
    bool "CRC16-X25"
    default n

config _ALGO_CRC16_XMODEM_ENABLE
    bool "CRC16-XMODEM"
    default n

config _ALGO_CRC16_DNP_ENABLE
    bool "CRC16-DNP"
    default n

config _ALGO_CRC32_ENABLE
    bool "CRC32"
    default n

config _ALGO_CRC32_MPEG2_ENABLE
    bool "CRC32-MPEG2"
    default n

endif

endmenu
```

## bos/core/Kconfig
```kconfig
# Version Configuration
menu "Version Configuration"

config HW_VERSION
    int "Hardware version"
    default 211212
    help
        Hardware version number.

config FW_VERSION
    int "Firmware version"
    default 80700
    help
        Firmware version number.

config FW_NAME
    string "Firmware name"
    default "BabyOS"
    help
        Firmware name string.

endmenu
```

## bos/drivers/Kconfig
```kconfig
# Drivers Configuration
menu "Drivers Configuration"

#======================================== PCF8574 ========================================
config PCF8574_DEFAULT_OUTPUT
    int "PCF8574 default output value"
    default 0

#======================================== Matrix Keys ========================================
config MATRIX_KEYS_ROWS
    int "Maximum number of matrix key rows"
    default 4
    range 1 8

config MATRIX_KEYS_COLUMNS
    int "Maximum number of matrix key columns"
    default 4
    range 1 8

#======================================== ESP12F WiFi ========================================
config ESP12F_CMD_TX_BUF_LEN
    int "ESP12F command TX buffer length"
    default 128

config ESP12F_CMD_RX_BUF_LEN
    int "ESP12F command RX buffer length"
    default 1024 if !_MBEDTLS_ENABLE
    default 2560

config ESP12F_CMD_TIMEOUT
    int "ESP12F command timeout (ms)"
    default 5000

config ESP12F_LISTEN_PCB_NUMBER
    int "ESP12F listen PCB number"
    default 2

#======================================== RS485 ========================================
config RS485_RX_BUF_LEN
    int "RS485 RX buffer length"
    default 128

config RS485_RX_IDLE_MS
    int "RS485 RX idle timeout (ms)"
    default 50

config RS485_SWITCH_DELAY_US
    int "RS485 direction switch delay (us)"
    default 1000

choice
    prompt "RS485 receive data processing"
    default _485_USE_CALLBACK
config _485_USE_CALLBACK
    bool "Callback"
config _485_USE_SELECT
    bool "Select (polling)"
endchoice

if _485_USE_SELECT

config RS485_CACHE_BUF_LEN
    int "RS485 cache buffer size"
    default 1024

endif

#======================================== Display ========================================
config DISPLAY_CACHE_BUF_SIZE
    int "Display buffer size (pixels)"
    default 8

endmenu
```

## bos/hal/Kconfig
```kconfig
# HAL Configuration
menu "HAL Configuration"

config TICK_FRQ_HZ
    int "System tick frequency (Hz)"
    default 1000
    help
        System tick timer frequency for task scheduling.

config USER_TICK_ENABLE
    bool "Use user-provided tick interface"
    default n
    help
        Enable custom tick counter implementation.

config _HALIF_VARIABLE_ENABLE
    bool "HAL interface variable enable"
    default n
    help
        Enable runtime HAL interface configuration.

#======================================== Watchdog ========================================
config _WDT_ENABLE
    bool "Watchdog"
    default n

if _WDT_ENABLE

config WDT_TIMEOUT_S
    int "Watchdog timeout (seconds)"
    default 60

endif

endmenu
```

## bos/mcu/Kconfig
```kconfig
# MCU Configuration
menu "MCU Configuration"

#======================================== Vendor Selection ========================================
choice
    prompt "Select MCU Vendor"
config VENDOR_UBUNTU
    bool "Ubuntu (x86 simulation)"
config VENDOR_ST
    bool "STMicroelectronics"
config VENDOR_NATION
    bool "Nationstech"
config VENDOR_MM
    bool "Mindmotion"
config VENDOR_HC
    bool "HDSC"
config VENDOR_WCH
    bool "WinChipHead (WCH)"
config VENDOR_HOLTEK
    bool "Holtek"
config VENDOR_ARTERY
    bool "Artery"
config VENDOR_HK
    bool "HK (Hangshun)"
config VENDOR_ESPRESSIF
    bool "Espressif (ESP32)"
config VENDOR_PY
    bool "Puya (Puyuan)"
config VENDOR_CW
    bool "Chipstar (Xinyuan)"
endchoice

#======================================== ST Chips ========================================
if VENDOR_ST

choice
    prompt "Select ST Chip"
config STM32F10X_LD
    bool "STM32F10x LD (Low Density)"
config STM32F10X_MD
    bool "STM32F10x MD (Medium Density)"
config STM32F10X_HD
    bool "STM32F10x HD (High Density)"
config STM32F10X_CL
    bool "STM32F10x CL (Connectivity Line)"
config STM32G0X0
    bool "STM32G0x0"
config STM32L41X_L46X
    bool "STM32L41x/L46x"
config STM32F40X
    bool "STM32F40x"
config STM32G4XX
    bool "STM32G4xx"
config STM32H5XX
    bool "STM32H5xx"
config STM32L0X3
    bool "STM32L0x3"
config STM32G0B1
    bool "STM32G0B1"
endchoice

endif

#======================================== Nationstech Chips ========================================
if VENDOR_NATION

choice
    prompt "Select Nationstech Chip"
config NATION_L40X
    bool "NATION_L40X"
config NATION_G45X
    bool "NATION_G45X"
endchoice

endif

#======================================== Mindmotion Chips ========================================
if VENDOR_MM

choice
    prompt "Select Mindmotion Chip"
config MM32SPIN2X
    bool "MM32SPIN2X"
config MM32SPIN0X
    bool "MM32SPIN0X"
endchoice

endif

#======================================== HDSC Chips ========================================
if VENDOR_HC

choice
    prompt "Select HDSC Chip"
config HC32L13X
    bool "HC32L13X"
config HC32L07X
    bool "HC32L07X"
config HC32L17X
    bool "HC32L17X"
endchoice

endif

#======================================== WinChipHead Chips ========================================
if VENDOR_WCH

choice
    prompt "Select WinChipHead Chip"
config CH32F103
    bool "CH32F103"
endchoice

endif

#======================================== Holtek Chips ========================================
if VENDOR_HOLTEK

choice
    prompt "Select Holtek Chip"
config TH32F50343
    bool "TH32F50343"
endchoice

endif

#======================================== Artery Chips ========================================
if VENDOR_ARTERY

choice
    prompt "Select Artery Chip"
config AT32F403A
    bool "AT32F403A"
endchoice

endif

#======================================== HK (Hangshun) Chips ========================================
if VENDOR_HK

choice
    prompt "Select HK Chip"
config HK32F103
    bool "HK32F103"
endchoice

endif

#======================================== Espressif Chips ========================================
if VENDOR_ESPRESSIF

choice
    prompt "Select Espressif Chip"
config ESP32C3
    bool "ESP32-C3"
endchoice

endif

#======================================== Puya Chips ========================================
if VENDOR_PY

choice
    prompt "Select Puya Chip"
config PY32F002B
    bool "PY32F002B"
endchoice

endif

#======================================== Chipstar (Xinyuan) Chips ========================================
if VENDOR_CW

choice
    prompt "Select Chipstar Chip"
config CW32L010
    bool "CW32L010"
endchoice

endif

endmenu
```
